## drivers/media/platform/siengine/sensor/Kconfig
```kconfig
# SPDX-License-Identifier: GPL-2.0
#
#  Siengine Platform drivers
#	Drivers here are currently for sensor and serdes support

config SE_MAX96722
       tristate "Siengine MAX96722 Driver"
       default y

config SE_MAX9296
       tristate "Siengine MAX9296 Driver"
       default y

menuconfig SE_SENSOR_TYPE
	bool "Siengine Sensor Type support"
	default y
	help
	  Sensor support for Siengine Soc

if SE_SENSOR_TYPE

config CAMERA_OV01F10
	bool "OV 01F10 sensor support"
	default y
	help
	  Support for ov 01f10 sensor link using mipi bus.

config CAMERA_OVX3C10
	bool "OV OX03C10 sensor support"
	default y
	help
	  Support for ov Ox03c10 sensor link using mipi bus.


config CAMERA_AR0231
	bool "Onsemi AR0231 sensor support"
	default y
	help
	  Support for onsemi ar0231 sensor link using mipi bus.

config CAMERA_OV9284
	bool "OV 9284 sensor support"
	default y
	help
	  Support for ov 9284 sensor link using mipi bus.

config CAMERA_OV2311
	bool "OV 2311 sensor support"
	default y
	help
	  Support for ov ov2311 sensor link using mipi bus.

config CAMERA_OV2778_GW5400
	bool "OV 2778 GW5400 sensor support"
	default y
	help
	  Support for onsemi ov 2778 gw5400 sensor link using mipi bus.

endif # SE_SENSOR

config SE_AR0231
        tristate "Siengine AR0231 Driver"
        default n
```

## drivers/misc/se-switch/Kconfig
```kconfig
#
# mdp-switch device configuration
#

config SIENGINE_MDP_SWITCH
	bool "siengine mdp switch support"
#	depends on SIENGINE_FAKE_DISPLAY
	help
	    Choose this option for mdp switch on Siengine SoC.
```

## drivers/net/wireless/nxp/88w9098/Kconfig
```kconfig
# SPDX-License-Identifier: GPL-2.0-only

config 88W9098
	tristate "NXP 88W9098 WIFI module support"
	default m
	help
	  This option enables the wifi module in nxp drivers.
	  Select M (recommended), if you have a NXP 88w9098 wireless module.
```

## drivers/npu/Kconfig
```kconfig
#
# NPU device configuration
#

config NPU1_ZHOUYI
	tristate "NPU ZHOUYI support"
	default y
	help
	  Say Y here if you want to enable NPU-ZHOUYI support.
	  Operation Regions allow to support the AI computing for Neural network

#source "npu/zhouyi/Kconfig"
```

## drivers/pinctrl/siengine/Kconfig
```kconfig
config PINCTRL_SE1000
	bool "Siengine pinctrl driver"
	depends on OF
	select PINCONF
	select GPIOLIB
	select OF_GPIO
	select PINMUX
	select GENERIC_PINCONF
	select GENERIC_PINCTRL_GROUPS
	select GENERIC_PINMUX_FUNCTIONS
	help
	  Say Y here to enable the se1000 pinctrl driver

config PINMUX_SAF_ENABLE
	bool "Siengine pinmux safety gpio enable"
	depends on PINCTRL_SE1000
	help
	  Say Y here to enable the pinmux safety gpio enable
```

## drivers/siengine/Kconfig
```kconfig
menuconfig SIENGINE_MISC
	bool "SIENGINE MISC support"
	default n
	help
	  Say Y here to get to see options for siengine misc support.
	  This option alone does not add any kernel code.

	  If you say N, all options in this submenu will be skipped and disabled;
	  only do this if you know what you are doing.

if SIENGINE_MISC

config SE1000_HIFI_DSP
	tristate "SE1000 support for HIFI DSP5"
	help
	  This adds HIFI DSP driver for Siengine SE1000 boards
	  that can be used with other codecs.
	  Select Y if you have such device.
	  If unsure select "N".

config SE1000_ROOTFS_LOAD_SYNC
	tristate "rootfs load sync support"
	default n
	help
	  This option enables rootfs load sync feature, because CP boottime and
	  AP load rootfs image Parallel run. So we need sync mechnism to make sure
	  have the right data to unpack rootfs.

	  To compile this driver as a module, This feature can not be to ko.

config SE1000_PROF
        tristate "siengine bootprof support"
        default n
        help
          This option enable siengine performance data hather feature.
          Select Y if you need this function
          If unsure select "N"

config SE1000_DRM_SHMEM
	tristate "DRM shmem device support for DRM decrypt feature"
	default n
	help
	  This option enables shmem support for DRM decrypt feature.

config SE1000_EFUSE
       tristate "efuse device support for efuse access feature"
       default n
       help
         This option enables support for efuse access feature.

endif # SIENGINE_MISC
```

## sound/soc/siengine/Kconfig
```kconfig
config SND_SOC_SIENGINE
	select SND_SOC_GENERIC_DMAENGINE_PCM
	tristate

config SND_SOC_SE1000
	tristate "ASoC support for Siengine SE1000 chip"
	select SND_SOC_SIENGINE
	help
	  This adds ASoC driver for Siengine SE1000 boards
	  that can be used with other codecs.
	  Select Y if you have such device.
	  If unsure select "N".

config SND_SOC_SE1000_SHARE
	tristate "ASoC support for Siengine SE1000 chip"
	help
	  This adds ASoC driver for Siengine SE1000 boards
	  it used for AP and cp audio.
	  Select Y if you use this feature.
	  If unsure select "N".

config SND_SOC_SE1000_TDM_MLP
	tristate "ASoC support for Siengine SE1000 chip"
	help
	  This adds ASoC driver for Siengine SE1000 boards
	  it used for mtltiplm tdm.
	  Select Y if you use this feature.
	  If unsure select "N".

config SND_SOC_SE1000_LOOPBACK
	tristate "ASoC support for Siengine SE1000 chip"
	help
	  This adds ASoC driver for Siengine SE1000 boards
	  it used for hostless audio loopback.
	  Select Y if you use this feature.
	  If unsure select "N".
```
